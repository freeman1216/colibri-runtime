## CMakeLists.txt
```
cmake_minimum_required(VERSION 3.20.0)

set(ZEPHYR_TOOLCHAIN_VARIANT zephyr CACHE STRING "Zephyr toolchain variant")

find_package(Zephyr REQUIRED HINTS $ENV{ZEPHYR_BASE})
project(colibri_runtime C CXX ASM) # Enable ASM here, within the project call

target_include_directories(app PRIVATE
        lua/
        include/
)

target_sources(app PRIVATE
        src/main_mock.c
        #src/main.c
        src/events/events_mock.c
        #src/events/events.c
        #src/fs/fs_callback.c
        #src/fs/nvs.c
        #src/leds/neopixels.c
        #src/leds/leds.c
        #src/lua/load-lua.c
        #src/lua/lua.c
        src/lua/lua_mock.c
        #src/management/eeprom.c
        #src/modbus/modbus.c
        #src/slots/host-api.c
        #src/slots/slots.c
        #src/slots/slotcount.c
        #src/slots/i2c.c
        #src/slots/spi.c
        #src/tasks/io-subsystem.c
        #src/tasks/rgb-updater.c
        src/tasks/supervisor.c
        #src/usb/usb.c
        src/swtimer/swtimer.c

        lua/lapi.c
        lua/lbaselib.c
        lua/lctype.c
        lua/ldo.c
        lua/lfunc.c
        lua/linit.c
        lua/lmathlib.c
        lua/lobject.c
        lua/lparser.c
        lua/lstring.c
        lua/ltable.c
        lua/ltm.c
        lua/lvm.c
        lua/lauxlib.c
        lua/lcode.c
        lua/ldebug.c
        lua/ldump.c
        lua/lgc.c
        lua/llex.c
        lua/lmem.c
        lua/lopcodes.c
        lua/lstate.c
        lua/lstrlib.c
        lua/ltablib.c
        lua/lundump.c
        lua/lzio.c
        lua/helper/luaHeap_mock.c
        #lua/helper/luaHeap.c
)

target_compile_definitions(app PRIVATE
        # Platform & Optimization
        ARM
        M4_COMPILER_GCC
)

target_link_libraries(app PUBLIC m)

# TODO: Build of Colibri SDK, for creating I/O module drivers.
#
# For now, that is symlinked into colibri-drivers
```

## prj.conf
```kconfig
# Keep the DBGMCU clock running during low-power sleep modes
CONFIG_STM32_ENABLE_DEBUG_SLEEP_STOP=y

# Forces the CPU to keep JTAG/SWD pins allocated for debugging
CONFIG_DEBUG=y

# Essential Low-Level Hardware Drivers
CONFIG_SERIAL=y
CONFIG_UART_ASYNC_API=y
CONFIG_CONSOLE=y
CONFIG_UART_CONSOLE=y

# Base File System & Storage Layers
CONFIG_FLASH=y
CONFIG_FLASH_MAP=y
CONFIG_FILE_SYSTEM=y
CONFIG_FS_LITTLEFS_NUM_FILES=4

# Base Utilities that MCUmgr needs to unlock NET_BUF and ZCBOR
CONFIG_NET_BUF=y
CONFIG_ZCBOR=y
CONFIG_BASE64=y
CONFIG_CRC=y

# Classic USB Device Stack Setup
CONFIG_USB_DEVICE_STACK=y
CONFIG_USB_CDC_ACM=y
CONFIG_SERIAL=y
CONFIG_UART_LINE_CTRL=y

# Core MCUmgr Subsystem
#CONFIG_MCUMGR=y
#CONFIG_MCUMGR_TRANSPORT_WORKQUEUE_STACK_SIZE=4096
#CONFIG_MCUMGR_TRANSPORT_UART=y
#CONFIG_UART_MCUMGR=y
#CONFIG_MCUMGR_GRP_OS=y
#CONFIG_MCUMGR_GRP_FS=y
#CONFIG_MCUMGR_GRP_SHELL=y
#CONFIG_MCUMGR_GRP_SETTINGS=y
#CONFIG_MCUMGR_GRP_FS_FILE_ACCESS_HOOK=y
#CONFIG_MCUMGR_MGMT_NOTIFICATION_HOOKS=y

# Core Utilities required by MCUmgr
CONFIG_NET_BUF=y
CONFIG_ZCBOR=y
CONFIG_BASE64=y
CONFIG_CRC=y

# code snippets of max 2048 bytes + 6144 bytes for others
CONFIG_HEAP_MEM_POOL_SIZE=20480
CONFIG_SYS_HEAP_RUNTIME_STATS=n
CONFIG_MAIN_STACK_SIZE=4096
CONFIG_SYSTEM_WORKQUEUE_STACK_SIZE=4096

#CONFIG_NEWLIB_LIBC=y
CONFIG_PICOLIBC=y

# Lua stack management
CONFIG_STACK_SENTINEL=y
CONFIG_THREAD_STACK_INFO=y
CONFIG_INIT_STACKS=y
CONFIG_THREAD_ANALYZER=y
CONFIG_THREAD_ANALYZER_AUTO=y
CONFIG_THREAD_ANALYZER_USE_PRINTK=y

# Enable Serial
CONFIG_SERIAL=y
CONFIG_UART_STM32=y
CONFIG_UART_INTERRUPT_DRIVEN=y

# Console over USART2 (ST-Link VCP)
CONFIG_CONSOLE=y
CONFIG_UART_CONSOLE=y

# Logging via UART backend
CONFIG_PRINTK=y
CONFIG_LOG_BACKEND_UART=y
CONFIG_LOG_BUFFER_SIZE=1024

# Useful during bring-up: include board name in logs and keep asserts on
CONFIG_ASSERT=y

CONFIG_LED=y
CONFIG_LED_GPIO=y

CONFIG_I2C=y
CONFIG_PWM=y
CONFIG_SPI=y
CONFIG_LED_STRIP=y
CONFIG_WS2812_PWM=y
CONFIG_GPIO_TCA6424A=y

# Core Flash and Storage support
CONFIG_FLASH=y
CONFIG_FLASH_MAP=y
CONFIG_STREAM_FLASH=y

# Enable LittleFS
CONFIG_FILE_SYSTEM=y
CONFIG_FILE_SYSTEM_LITTLEFS=y
CONFIG_FILE_SYSTEM_MKFS=y

# Enable POSIX
CONFIG_POSIX_API=y

# Enable NVS
CONFIG_NVS=y
CONFIG_FLASH_PAGE_LAYOUT=y
CONFIG_SPI_NOR_FLASH_LAYOUT_PAGE_SIZE=4096

# Modbus support
CONFIG_MODBUS=y
CONFIG_MODBUS_ROLE_SERVER=y
CONFIG_MODBUS_SERIAL=y

# Debugging flags
#CONFIG_I2C_LOG_LEVEL_DBG=n
#CONFIG_GPIO_LOG_LEVEL_DBG=n
#CONFIG_SPI_LOG_LEVEL_DBG=n
CONFIG_THREAD_MONITOR=y
CONFIG_THREAD_NAME=y

# Optimzations
CONFIG_LOG=y
# CONFIG_LINKER_ORPHAN_SECTION_WARN=y
# CONFIG_CBPRINTF_NANO=y
# CONFIG_BOOT_BANNER=n
```

## app.overlay
```dts
/* / { */
/* 	aliases { */
/* 		modbus0 = &modbus0; */
/* 	}; */
/* }; */

&usart1 {
	status = "okay";
	/* Modbus as a child of the UART */
	/* modbus0: modbus0 { */
	/* 	compatible = "zephyr,modbus-serial"; */
	/* 	status = "okay"; */
	/* 	de-gpios = <&gpiob 12 GPIO_ACTIVE_HIGH>; */
	/* }; */
};
```

## src/main_mock.c
```c
/*
 * Copyright (c) 2024 CurrentMakers
 *
 * SPDX-License-Identifier: Apache-2.0
 */

#include <zephyr/kernel.h>
#include <zephyr/drivers/gpio.h>
#include <zephyr/fs/fs.h>
#include <string.h>

#include "colibri-sdk/colibri-events.h"
#include "colibri/events.h"
//#include "colibri/fs.h"
//#include "colibri/leds.h"
#include "colibri/luaInterface.h"
//#include "colibri/management.h"
//#include "colibri/modbus.h"
//#include "colibri/slots.h"
#include "colibri/tasks.h"
//#include "colibri/usb.h"

int main()
{
    int error = events_initialize();
    
    return 0;
}
```
